## examples/halow_gateway/main/Kconfig.projbuild
```kconfig
menu "T-Halow-P4 HaLow gateway example"

config GW_WIFI_STA_SSID
    string "Home WiFi SSID (C6 joins as station)"
    default "your-2g4-ssid"
    help
        Must be a 2.4 GHz network -- the onboard ESP32-C6 has no 5 GHz radio.

config GW_WIFI_STA_PASSWORD
    string "Home WiFi password"
    default ""

config GW_HALOW_IP
    string "Gateway address on the HaLow BSS"
    default "10.99.0.1"
    help
        The HaLow side runs a DHCP server; clients lease from this /24 and are
        NAT'd out over the home WiFi. This address is also the gateway and the
        DNS relay target handed to them.

config GW_HALOW_NETMASK
    string "HaLow netmask"
    default "255.255.255.0"

config GW_DNS_FALLBACK
    string "DNS offered to HaLow clients before the WiFi lease arrives"
    default "8.8.8.8"

endmenu
```

## examples/halow_node/main/Kconfig.projbuild
```kconfig
menu "T-Halow-P4 HaLow node example"

comment "One image, two personalities: the persisted HaLow role selects it."
comment "sta = router (SoftAP + NAT onto HaLow); ap = gateway (home-WiFi STA"
comment "+ DHCP server on HaLow). All WiFi credentials here are defaults only;"
comment "values saved via the portal (POST /api/wifi) override them from NVS."

config NODE_DEFAULT_ROLE_AP
    bool "Default personality is gateway (HaLow AP)"
    default n
    help
        Only used before a role has ever been set from the config page.

config NODE_WIFI_AP_SSID
    string "SoftAP SSID (router personality)"
    default "halow-router"

config NODE_WIFI_AP_PASSWORD
    string "SoftAP password"
    default "halowrouter"
    help
        WPA2-PSK, at least 8 characters. Empty for an open AP.

config NODE_WIFI_AP_CHANNEL
    int "SoftAP channel"
    range 1 13
    default 1

config NODE_WIFI_STA_SSID
    string "Home WiFi SSID (gateway personality, 2.4 GHz)"
    default "your-2g4-ssid"

config NODE_WIFI_STA_PASSWORD
    string "Home WiFi password"
    default ""

config NODE_HALOW_GW_IP
    string "Gateway address on the HaLow BSS (gateway personality)"
    default "10.99.0.1"

config NODE_HALOW_GW_NETMASK
    string "HaLow netmask (gateway personality)"
    default "255.255.255.0"

config NODE_DNS_FALLBACK
    string "DNS offered to clients before an upstream lease supplies one"
    default "8.8.8.8"

config NODE_HALOW_USE_DHCP
    bool "Router personality: obtain the HaLow address by DHCP"
    default y
    help
        The normal topology: lease from a halow_node gateway (or a bridged LAN).
        Disable for a bare BSS and set the static fields.

config NODE_HALOW_STATIC_IP
    string "Router personality: static IPv4 address"
    depends on !NODE_HALOW_USE_DHCP
    default "10.99.0.2"

config NODE_HALOW_STATIC_NETMASK
    string "Router personality: static netmask"
    depends on !NODE_HALOW_USE_DHCP
    default "255.255.255.0"

config NODE_HALOW_STATIC_GW
    string "Router personality: static gateway"
    depends on !NODE_HALOW_USE_DHCP
    default "10.99.0.1"

comment "Camera streaming: runs only when a CSI sensor answers at boot."

config NODE_CAMERA_STREAM
    bool "Serve an H.264 camera stream when a sensor is present"
    default y
    help
        Hardware pipeline (CSI -> ISP -> H.264) served as a raw Annex-B
        elementary stream to one TCP client:
        ffplay -fflags nobuffer -f h264 tcp://<node>:8554

config NODE_STREAM_PORT
    int "TCP port for the H.264 stream"
    default 8554

config NODE_STREAM_STOPS_WIFI
    bool "Park the 2.4 GHz radio while a viewer is connected"
    default n
    help
        Stops WiFi for the duration of a viewing session, on the theory
        that it frees internal DMA-capable RAM for the pipeline. Measured
        on this board it does not: the free DMA heap went down, not up.
        Left here as a switch, off by default, since a field unit that
        never serves its SoftAP may still want the radio quiet.

config NODE_JPEG_QUALITY
    int "Default JPEG quality for the browser preview (5-95)"
    range 5 95
    default 40
    help
        The /camera page can raise or lower this live; the default is chosen
        to keep frames small enough to preview over HaLow as well as over
        the node's own SoftAP.

config NODE_H264_BITRATE
    int "H.264 target bitrate (bit/s)"
    default 800000
    range 25000 2500000
    help
        Keep below what the HaLow link sustains (~1-4 Mbit/s measured at
        2 MHz bandwidth) or latency grows without bound.

config NODE_H264_I_PERIOD
    int "H.264 I-frame period (frames)"
    default 50
    range 1 120

config NODE_H264_MIN_QP
    int "H.264 minimum QP"
    default 25
    range 1 51

config NODE_H264_MAX_QP
    int "H.264 maximum QP"
    default 48
    range NODE_H264_MIN_QP 51

config NODE_STREAM_FORWARD
    bool "Gateway personality: forward the stream port over HaLow"
    default y
    help
        NAT port-map so the home LAN can watch the camera through this
        board: <gateway wifi ip>:8554 -> <camera halow ip>:8554.

config NODE_STREAM_FORWARD_IP
    string "HaLow address of the camera node"
    depends on NODE_STREAM_FORWARD
    default "10.99.0.2"
    help
        First DHCP lease the gateway hands out; with a single field unit
        on the BSS that is always the camera.

config NODE_MGMT_FORWARD_PORT
    int "Gateway port mapped to the field unit's config portal"
    depends on NODE_STREAM_FORWARD
    default 8080
    help
        http://<gateway>:8080/ is the field unit's own page, reached over
        HaLow -- remote reconfiguration and OTA without going to the camera.

endmenu
```

## examples/halow_router/main/Kconfig.projbuild
```kconfig
menu "T-Halow-P4 HaLow router example"

config ROUTER_WIFI_SSID
    string "WiFi SoftAP SSID"
    default "halow-router"

config ROUTER_WIFI_PASSWORD
    string "WiFi SoftAP password"
    default "halowrouter"
    help
        WPA2-PSK, at least 8 characters. Leave empty for an open AP.

config ROUTER_WIFI_CHANNEL
    int "WiFi SoftAP channel"
    range 1 13
    default 1

config HALOW_USE_DHCP
    bool "Obtain a HaLow-side address by DHCP"
    default n
    help
        A bare HaLow BSS has no DHCP server. Enable this only when the AP-side
        module bridges onto an ethernet segment that has one.

config HALOW_STATIC_IP
    string "HaLow static IPv4 address"
    depends on !HALOW_USE_DHCP
    default "10.99.0.2"

config HALOW_STATIC_NETMASK
    string "HaLow static IPv4 netmask"
    depends on !HALOW_USE_DHCP
    default "255.255.255.0"

config HALOW_STATIC_GW
    string "HaLow static IPv4 gateway"
    depends on !HALOW_USE_DHCP
    default "10.99.0.1"

config HALOW_DNS
    string "DNS server offered to WiFi clients"
    depends on !HALOW_USE_DHCP
    default "8.8.8.8"
    help
        With a static HaLow address there is no DHCP lease to learn a DNS server
        from, so this one is used by the router and offered to WiFi clients.

endmenu
```
