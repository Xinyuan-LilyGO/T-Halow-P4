## debug/iperf/sdkconfig.defaults.esp32p4
```kconfig
#### Comment below two lines if present:
# CONFIG_ESP_HOST_WIFI_ENABLED=y
# CONFIG_PARTITION_TABLE_SINGLE_APP_LARGE=y

#### Add Wi-Fi Remote config for better performance:
CONFIG_ESP_WIFI_STATIC_RX_BUFFER_NUM=16
CONFIG_ESP_WIFI_DYNAMIC_RX_BUFFER_NUM=64
CONFIG_ESP_WIFI_DYNAMIC_TX_BUFFER_NUM=64
CONFIG_ESP_WIFI_AMPDU_TX_ENABLED=y
CONFIG_ESP_WIFI_TX_BA_WIN=32
CONFIG_ESP_WIFI_AMPDU_RX_ENABLED=y
CONFIG_ESP_WIFI_RX_BA_WIN=32

CONFIG_LWIP_TCP_SND_BUF_DEFAULT=65534
CONFIG_LWIP_TCP_WND_DEFAULT=65534
CONFIG_LWIP_TCP_RECVMBOX_SIZE=64
CONFIG_LWIP_UDP_RECVMBOX_SIZE=64
CONFIG_LWIP_TCPIP_RECVMBOX_SIZE=64

CONFIG_LWIP_TCP_SACK_OUT=y
```

## examples/camera_display/sdkconfig.defaults
```kconfig
CONFIG_IDF_TARGET="esp32p4"
CONFIG_ESPTOOLPY_FLASHSIZE_16MB=y
CONFIG_PARTITION_TABLE_CUSTOM=y
CONFIG_PARTITION_TABLE_CUSTOM_FILENAME="partitions.csv"
//CONFIG_PARTITION_TABLE_CUSTOM_FILENAME="partitions_model.csv"

CONFIG_SPIRAM=y
CONFIG_SPIRAM_MODE_HEX=y
CONFIG_SPIRAM_SPEED_200M=y

CONFIG_CACHE_L2_CACHE_256KB=y
CONFIG_CACHE_L2_CACHE_LINE_128B=y


CONFIG_FATFS_LFN_HEAP=y

CONFIG_IDF_EXPERIMENTAL_FEATURES=y

CONFIG_ESP_VIDEO_ENABLE_ISP_PIPELINE_CONTROLLER=y

# CONFIG_CAMERA_SC2336=y
# CONFIG_CAMERA_SC2336_CUSTOMIZED_IPA_JSON_CONFIGURATION_FILE=y
# CONFIG_CAMERA_SC2336_CUSTOMIZED_IPA_JSON_CONFIGURATION_FILE_PATH="components/private_library/sc2336_ipa_config.json"
# CONFIG_CAMERA_SC2336_MIPI_RAW10_1280x720_30FPS=y

CONFIG_CAMERA_OV2710=y
CONFIG_CAMERA_OV2710_CUSTOMIZED_IPA_JSON_CONFIGURATION_FILE=y
CONFIG_CAMERA_OV2710_CUSTOMIZED_IPA_JSON_CONFIGURATION_FILE_PATH="components/private_library/ov2710_ipa_config.json"
CONFIG_CAMERA_OV2710_MIPI_RAW10_1280X720_25FPS=y

# CONFIG_CAMERA_OV5645=y
# CONFIG_CAMERA_OV5645_MIPI_RGB565_1280X960_30FPS=y

CONFIG_FREERTOS_TIMER_TASK_STACK_DEPTH=8192
```

## examples/factory_esp_brookesia_v8/components/esp_brookesia_app/Kconfig.projbuild
```kconfig
menu "Video Configuration"

    config EXAMPLE_ENABLE_MIPI_CSI_CAM_SENSOR
        bool "Enable MIPI CSI Camera Sensor"
        default y
        depends on SOC_MIPI_CSI_SUPPORTED

    if EXAMPLE_ENABLE_MIPI_CSI_CAM_SENSOR
        config EXAMPLE_MIPI_CSI_SCCB_I2C_PORT
            int "MIPI CSI SCCB I2C Port Number"
            default 0
            range 0 1

        config EXAMPLE_MIPI_CSI_SCCB_I2C_SCL_PIN
            int "MIPI CSI SCCB I2C SCL Pin"
            default 21
            range -1 56

        config EXAMPLE_MIPI_CSI_SCCB_I2C_SDA_PIN
            int "MIPI CSI SCCB I2C SDA Pin"
            default 20
            range -1 56

        config EXAMPLE_MIPI_CSI_SCCB_I2C_FREQ
            int "MIPI CSI SCCB I2C Frequency"
            default 100000
            range 100000 400000
            help
                Increasing this value can reduce the initialization time of the camera sensor.
                Please refer to the relevant instructions of the camera sensor to adjust the value.

        config EXAMPLE_MIPI_CSI_CAM_SENSOR_RESET_PIN
            int "MIPI CSI Camera Sensor Reset Pin"
            default -1
            range -1 56

        config EXAMPLE_MIPI_CSI_CAM_SENSOR_PWDN_PIN
            int "MIPI CSI Camera Sensor Power Down Pin"
            default -1
            range -1 56
    endif

    choice BSP_LCD_COLOR_FORMAT
        prompt "Select LCD color format"
        default BSP_LCD_COLOR_FORMAT_RGB565
        help
            Select the LCD color format RGB565/RGB888.

        config BSP_LCD_COLOR_FORMAT_RGB565
            bool "RGB565"
        config BSP_LCD_COLOR_FORMAT_RGB888
            bool "RGB888"
    endchoice   

    # config CONFIG_BSP_LCD_COLOR_FORMAT_RGB565
    #     bool 
    #     default y

    config EXAMPLE_ENABLE_PRINT_FPS_RATE_VALUE
        bool "enable print fps rate value"
        default y

    config EXAMPLE_ENABLE_CAM_SENSOR_PIC_VFLIP
        bool "Enable Camera Sensor Picture Vertical Flip"
        default n
        help
            Select this option, enable camera sensor picture vertical flip.

    config EXAMPLE_ENABLE_CAM_SENSOR_PIC_HFLIP
        bool "Enable Camera Sensor Picture Horizontal Flip"
        default n
        help
            Select this option, enable camera sensor picture horizontal flip.

endmenu
```

## examples/halow_netif/main/Kconfig.projbuild
```kconfig
menu "T-Halow-P4 HaLow netif example"

config HALOW_ROLE_AP
    bool "Configure the HaLow module as AP"
    default n
    help
        Leave unset to run as a station. The radio's SSID, channel, bandwidth and
        encryption are configured over the AT console, not here.

config HALOW_USE_DHCP
    bool "Obtain an address by DHCP"
    default n
    help
        A bare HaLow BSS has no DHCP server. Enable this only when the AP-side
        module bridges onto an ethernet segment that has one.

config HALOW_STATIC_IP
    string "Static IPv4 address"
    depends on !HALOW_USE_DHCP
    default "10.99.0.2"

config HALOW_STATIC_NETMASK
    string "Static IPv4 netmask"
    depends on !HALOW_USE_DHCP
    default "255.255.255.0"

config HALOW_STATIC_GW
    string "Static IPv4 gateway"
    depends on !HALOW_USE_DHCP
    default "10.99.0.1"

endmenu
```

## main/Kconfig.projbuild
```kconfig
menu "Example Configuration"

    choice
        prompt "Select the example to build"
        default EXAMPLE_BUILD_TX_AH_R900PNR_SPEED_TEST
            config EXAMPLE_BUILD_TX_AH_R900PNR
                bool "tx_ah_r900pnr"
            config EXAMPLE_BUILD_TX_AH_R900PNR_SPEED_TEST
                bool "tx_ah_r900pnr_speed_test"
    endchoice

endmenu
```
